## examples/still_capture/boards/stm32n6570_dk_stm32n657xx_sb.conf
```kconfig
# Video buffer pool in the external PSRAM
CONFIG_MEMC=y
CONFIG_VIDEO_BUFFER_POOL_ZEPHYR_REGION=y
CONFIG_VIDEO_BUFFER_POOL_ZEPHYR_REGION_NAME="PSRAM"
CONFIG_VIDEO_BUFFER_POOL_HEAP_SIZE=20059200

# Use RTT instead of UART
CONFIG_USE_SEGGER_RTT=y
CONFIG_RTT_CONSOLE=y
CONFIG_SEGGER_RTT_BUFFER_SIZE_UP=4096
CONFIG_SEGGER_RTT_SECTION_CUSTOM_DTS_REGION=y
CONFIG_SERIAL=n
CONFIG_UART_CONSOLE=n
```
